/*
 * Jal Sakhi — Village Water Sentinel Node
 * Target: ESP32-WROOM-32 + ADS1115 + DS18B20 + JSN-SR04T + SX1278 (LoRa)
 *
 * Responsibilities of this firmware:
 *   1. Sample four water-quality channels and one tank-level channel.
 *   2. Reject transients (air bubbles, probe knocks) with a median-of-N filter.
 *   3. Temperature-compensate the conductivity-derived TDS reading.
 *   4. Score the sample against a Mahalanobis model exported by ml/train_model.py.
 *   5. Apply IS 10500:2012 hard limits as a safety guard the model cannot override.
 *   6. Transmit a compact packet over LoRa and deep-sleep until the next cycle.
 *
 * Team 11 — Review 2 build (firmware v0.3)
 */

#include <Wire.h>
#include <Adafruit_ADS1X15.h>
#include <OneWire.h>
#include <DallasTemperature.h>
#include <SPI.h>
#include <LoRa.h>
#include "model_params.h"   // generated by ml/train_model.c — do not hand-edit
#include "scoring.h"        // shared with the trainer: same maths, both sides

// ---------------------------------------------------------------- pin map
#define PIN_ONEWIRE      4    // DS18B20 data
#define PIN_TRIG        25    // JSN-SR04T trigger
#define PIN_ECHO        26    // JSN-SR04T echo
#define PIN_PROBE_PWR   27    // MOSFET gate: powers EC/pH front end only while sampling
#define LORA_SS         18
#define LORA_RST        14
#define LORA_DIO0       33

// ADS1115 single-ended channels
#define CH_TDS           0
#define CH_TURBIDITY     1
#define CH_PH            2

// ---------------------------------------------------------------- tuning
#define SAMPLES_PER_READ     9      // odd, for a true median
#define SETTLE_MS          800      // probe settling after power-up
#define SLEEP_MINUTES       15
#define TANK_HEIGHT_CM     180.0f   // surveyed height of the community tank
#define CONFIRM_WINDOW       5      // alert only after 3 anomalies in last 5 cycles
#define CONFIRM_REQUIRED     3

Adafruit_ADS1115 ads;
OneWire oneWire(PIN_ONEWIRE);
DallasTemperature tempSensor(&oneWire);

RTC_DATA_ATTR uint8_t  anomalyHistory = 0;   // survives deep sleep: bitfield of last 8 cycles
RTC_DATA_ATTR uint32_t cycleCount     = 0;

struct Reading {
  float tds;          // mg/L, 25 C compensated
  float turbidity;    // NTU
  float ph;
  float tempC;
  float levelPct;     // 0-100
  float score;        // Mahalanobis distance
  uint8_t verdict;    // 0 safe, 1 watch, 2 unsafe
  uint8_t reason;     // bitfield, see JAL_REASON_* in scoring.h
};

// Reason flags (JAL_REASON_MODEL, _PH, _TURBIDITY, _TDS, _LEVEL) and the
// IS 10500 limits come from scoring.h, so the node, the trainer and the
// gateway all agree on what each bit means.

// ------------------------------------------------------- helpers: filtering
static int cmpFloat(const void *a, const void *b) {
  float d = *(const float *)a - *(const float *)b;
  return (d > 0) - (d < 0);
}

// Median rejects the single-sample spikes that a trailing mean would smear
// across the whole window. Bubbles on the turbidity probe were our main source
// of false positives on the bench rig (see docs/PROBLEM_LOG.md, entry P-04).
static float medianOf(float *buf, int n) {
  qsort(buf, n, sizeof(float), cmpFloat);
  return buf[n / 2];
}

// ------------------------------------------------------- helpers: transducers
static float readADCVolts(uint8_t channel) {
  int16_t raw = ads.readADC_SingleEnded(channel);
  return ads.computeVolts(raw);
}

// Gravity analog TDS: manufacturer polynomial, then linear temp compensation.
// Conductivity rises ~2 %/C, so an uncompensated probe reads a warm afternoon
// sample as if it were 20 % saltier than the same water at dawn.
static float voltsToTDS(float v, float tempC) {
  float comp = jal_temp_compensate(v, tempC);
  return (133.42f * comp * comp * comp
        - 255.86f * comp * comp
        + 857.39f * comp) * 0.5f;
}

// Two-point calibration against 0 NTU (distilled) and a 100 NTU formazin
// standard prepared in the lab. Slope/intercept live in model_params.h so the
// same constants are used by the trainer and the node.
static float voltsToTurbidity(float v) {
  float ntu = TURB_SLOPE * v + TURB_INTERCEPT;
  return ntu < 0.0f ? 0.0f : ntu;
}

// pH probe calibrated with pH 4.01 / 6.86 / 9.18 buffer sachets.
static float voltsToPH(float v) {
  return PH_SLOPE * v + PH_INTERCEPT;
}

static float readLevelPct() {
  float buf[SAMPLES_PER_READ];
  for (int i = 0; i < SAMPLES_PER_READ; i++) {
    digitalWrite(PIN_TRIG, LOW);  delayMicroseconds(4);
    digitalWrite(PIN_TRIG, HIGH); delayMicroseconds(10);
    digitalWrite(PIN_TRIG, LOW);
    long us = pulseIn(PIN_ECHO, HIGH, 30000UL);
    buf[i] = (us == 0) ? TANK_HEIGHT_CM : (us * 0.0343f) / 2.0f;  // cm to surface
    delay(60);
  }
  float dist = medianOf(buf, SAMPLES_PER_READ);
  float pct  = 100.0f * (TANK_HEIGHT_CM - dist) / TANK_HEIGHT_CM;
  return constrain(pct, 0.0f, 100.0f);
}

// ------------------------------------------------------- anomaly scoring
// Scoring lives in scoring.h, compiled into both this firmware and the desktop
// trainer, so the threshold the model was fitted against and the distance
// computed here cannot drift apart. MU[], LINV[][] and SCORE_THRESHOLD are
// exported by ml/train_model.c.
//
// Mahalanobis was chosen over Isolation Forest for the node because it is 96
// bytes of constants and about 200 float operations; the forest stays on the
// gateway where a second opinion is cheap. Justification in the Review 2
// report, section 3.

static uint8_t popcount8(uint8_t v) {
  uint8_t c = 0;
  while (v) { c += v & 1; v >>= 1; }
  return c;
}

// ------------------------------------------------------- sampling cycle
static Reading takeReading() {
  Reading r;

  digitalWrite(PIN_PROBE_PWR, HIGH);
  delay(SETTLE_MS);

  tempSensor.requestTemperatures();
  r.tempC = tempSensor.getTempCByIndex(0);
  if (r.tempC < -50.0f || r.tempC > 80.0f) r.tempC = 25.0f;  // sensor fault fallback

  float tdsBuf[SAMPLES_PER_READ], turbBuf[SAMPLES_PER_READ], phBuf[SAMPLES_PER_READ];
  for (int i = 0; i < SAMPLES_PER_READ; i++) {
    // The EC-type TDS probe and the pH probe share the water body and inject
    // current into each other if both are read while energised together, so
    // they are sampled in separate slots with a settle gap (problem P-02).
    tdsBuf[i]  = voltsToTDS(readADCVolts(CH_TDS), r.tempC);
    delay(30);
    turbBuf[i] = voltsToTurbidity(readADCVolts(CH_TURBIDITY));
    delay(30);
    phBuf[i]   = voltsToPH(readADCVolts(CH_PH));
    delay(60);
  }

  digitalWrite(PIN_PROBE_PWR, LOW);   // de-energise: electrolysis kills EC probes

  r.tds       = medianOf(tdsBuf,  SAMPLES_PER_READ);
  r.turbidity = medianOf(turbBuf, SAMPLES_PER_READ);
  r.ph        = medianOf(phBuf,   SAMPLES_PER_READ);
  r.levelPct  = readLevelPct();

  float x[N_FEATURES] = { r.tds, r.turbidity, r.ph, r.tempC };
  r.score  = jal_mahalanobis(x, MU, &LINV[0][0], N_FEATURES);
  r.reason = jal_hard_limits(r.tds, r.turbidity, r.ph, r.levelPct);
  if (r.score > SCORE_THRESHOLD) r.reason |= JAL_REASON_MODEL;

  return r;
}

// ------------------------------------------------------- transmit
static void transmit(const Reading &r) {
  // Fixed-width CSV keeps the LoRa payload under 40 bytes, which matters at
  // SF9 where airtime is billed in tens of milliseconds and the duty cycle
  // budget is shared with three other nodes on the same gateway.
  char pkt[48];
  snprintf(pkt, sizeof(pkt), "%lu,%.0f,%.1f,%.2f,%.1f,%.0f,%.1f,%u,%u",
           (unsigned long)cycleCount, r.tds, r.turbidity, r.ph,
           r.tempC, r.levelPct, r.score, r.verdict, r.reason);

  LoRa.beginPacket();
  LoRa.print(NODE_ID);
  LoRa.print(',');
  LoRa.print(pkt);
  LoRa.endPacket();
}

// ------------------------------------------------------- setup / loop
void setup() {
  Serial.begin(115200);

  pinMode(PIN_TRIG, OUTPUT);
  pinMode(PIN_ECHO, INPUT);
  pinMode(PIN_PROBE_PWR, OUTPUT);
  digitalWrite(PIN_PROBE_PWR, LOW);

  Wire.begin();
  ads.setGain(GAIN_ONE);            // +/-4.096 V full scale
  if (!ads.begin()) {
    Serial.println("ADS1115 not found — halting");
    while (true) delay(1000);
  }
  tempSensor.begin();

  LoRa.setPins(LORA_SS, LORA_RST, LORA_DIO0);
  if (!LoRa.begin(865E6)) {         // 865-867 MHz ISM band, licence-free in India
    Serial.println("LoRa init failed — halting");
    while (true) delay(1000);
  }
  LoRa.setSpreadingFactor(9);
  LoRa.setSyncWord(0x2B);

  Reading r = takeReading();

  // Three anomalous cycles inside the last five before we wake anybody up.
  // A single bad sample at 03:00 is almost always a bubble, not cholera.
  anomalyHistory = (anomalyHistory << 1) | (r.reason ? 1 : 0);
  uint8_t recent = anomalyHistory & ((1 << CONFIRM_WINDOW) - 1);
  uint8_t hits   = popcount8(recent);

  if (r.reason & (JAL_REASON_PH | JAL_REASON_TURBIDITY | JAL_REASON_TDS)) {
    r.verdict = 2;                                   // hard limit breached
  } else if ((r.reason & (JAL_REASON_MODEL | JAL_REASON_LEVEL)) &&
             hits >= CONFIRM_REQUIRED) {
    r.verdict = 2;                                   // confirmed model alert
  } else if (r.reason) {
    r.verdict = 1;                                   // watch, not yet notified
  } else {
    r.verdict = 0;
  }

  Serial.printf("TDS %.0f  NTU %.1f  pH %.2f  T %.1f  Lvl %.0f%%  d %.2f  v %u\n",
                r.tds, r.turbidity, r.ph, r.tempC, r.levelPct, r.score, r.verdict);

  transmit(r);
  cycleCount++;

  LoRa.sleep();
  esp_sleep_enable_timer_wakeup((uint64_t)SLEEP_MINUTES * 60ULL * 1000000ULL);
  esp_deep_sleep_start();
}

void loop() { /* unreachable: every cycle ends in deep sleep */ }
